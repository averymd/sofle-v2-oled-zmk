## config/west.yml
```yaml
manifest:
  remotes:
    - name: zmkfirmware
      url-base: https://github.com/zmkfirmware
    - name: mctechnology17
      url-base: https://github.com/mctechnology17
    - name: whoop-t
      url-base: https://github.com/whoop-t
    - name: averymd
      url-base: https://github.com/averymd
    - name: urob
      url-base: https://github.com/urob
  projects:
    - name: zmk
      remote: zmkfirmware
      revision: main
      import: app/west.yml
    - name: nice-adventure-time
      remote: whoop-t
      revision: main
    - name: zmk-nice-oled
      remote: averymd
      revision: main
    - name: zmk-helpers
      remote: urob
      revision: b1548efd28d2cc64b9506654e6883695c258190f
  self:
    path: config
```
